## conf/distro/alinuxi.conf
```bitbake
DISTRO = "alinuxi"
DISTRO_NAME = "Alinuxi (Alexi Linux Distribution)"
DISTRO_VERSION = "1.0.0"
DISTRO_CODENAME = "gatesgarth"
SDK_VENDOR = "-pokysdk"
SDK_VERSION = "${@d.getVar('DISTRO_VERSION').replace('snapshot-${DATE}', 'snapshot')}"

MAINTAINER = "Alexi Demers <alexidemers@gmail.com>"

TARGET_VENDOR = "-alexi"

LOCALCONF_VERSION = "1"

DISTRO_VERSION[vardepsexclude] = "DATE"
SDK_VERSION[vardepsexclude] = "DATE"

# Override these in poky based distros
POKY_DEFAULT_DISTRO_FEATURES = "alsa ext2 ipv4 largefile usbhost zeroconf vfat opengl wifi "
POKY_DEFAULT_EXTRA_RDEPENDS = "packagegroup-core-boot"
POKY_DEFAULT_EXTRA_RRECOMMENDS = "kernel-module-af-packet"

DISTRO_FEATURES = "${POKY_DEFAULT_DISTRO_FEATURES} virtualization seccomp"

SDK_NAME = "${DISTRO}-${TCLIBC}-${SDKMACHINE}-${IMAGE_BASENAME}-${TUNE_PKGARCH}-${MACHINE}"
SDKPATH = "/opt/${DISTRO}/${SDK_VERSION}"

DISTRO_EXTRA_RDEPENDS += " ${POKY_DEFAULT_EXTRA_RDEPENDS}"
DISTRO_EXTRA_RRECOMMENDS += " ${POKY_DEFAULT_EXTRA_RRECOMMENDS}"

IMAGE_FEATURES += "package-management"

TCLIBCAPPEND = ""

PREMIRRORS ??= "\
bzr://.*/.*   http://downloads.yoctoproject.org/mirror/sources/ \n \
cvs://.*/.*   http://downloads.yoctoproject.org/mirror/sources/ \n \
git://.*/.*   http://downloads.yoctoproject.org/mirror/sources/ \n \
gitsm://.*/.* http://downloads.yoctoproject.org/mirror/sources/ \n \
hg://.*/.*    http://downloads.yoctoproject.org/mirror/sources/ \n \
osc://.*/.*   http://downloads.yoctoproject.org/mirror/sources/ \n \
p4://.*/.*    http://downloads.yoctoproject.org/mirror/sources/ \n \
svn://.*/.*   http://downloads.yoctoproject.org/mirror/sources/ \n"

SANITY_TESTED_DISTROS ?= " \
            poky-3.0 \n \
            poky-3.1 \n \
            poky-3.2 \n \
            ubuntu-16.04 \n \
            ubuntu-18.04 \n \
            ubuntu-20.04 \n \
            fedora-30 \n \
            fedora-31 \n \
            fedora-32 \n \
            centos-7 \n \
            centos-8 \n \
            debian-8 \n \
            debian-9 \n \
            debian-10 \n \
            opensuseleap-15.1 \n \
            "
# add poky sanity bbclass
INHERIT += "poky-sanity"

# QA check settings - a little stricter than the OE-Core defaults
# (none currently necessary as we now match OE-Core)
#WARN_TO_ERROR_QA = "X"
#WARN_QA_remove = "${WARN_TO_ERROR_QA}"
#ERROR_QA_append = " ${WARN_TO_ERROR_QA}"

require conf/distro/include/poky-world-exclude.inc
require conf/distro/include/no-static-libs.inc
require conf/distro/include/yocto-uninative.inc
require conf/distro/include/security_flags.inc
INHERIT += "uninative"

BB_SIGNATURE_HANDLER ?= "OEEquivHash"
BB_HASHSERVE ??= "auto"

DISTRO_FEATURES += "ext2 pam opengl usbhost ${DISTRO_FEATURES_LIBC} systemd"
DISTRO_FEATURES:remove = "sysvinit"

VIRTUAL-RUNTIME_init_manager = "systemd"

DISTRO_FEATURES_BACKFILL_CONSIDERED += "pulseaudio"

PREFERRED_PROVIDER:jpeg = "libjpeg-turbo"
PREFERRED_PROVIDER:jpeg-native = "libjpeg-turbo-native"

PREFERRED_PROVIDER:udev = "eudev"

MACHINE_FEATURES:remove = "apm"

PACKAGE_CLASSES = "package_ipk"

PATCHRESOLVE = "noop"

# Heavily recommended for Wayland/Weston.
DISPMANX_OFFLINE = "1"

INHERIT += "buildhistory buildstats"

SDK_EXT_TYPE = "minimal"

INHERIT += "extrausers"
EXTRA_USERS_PARAMS = "usermod -P root root; "

PACKAGE_FEED_URIS = "http://tour.mdb.io/"
PACKAGE_FEED_BASE_PATHS = "ipk"
```

## conf/layer.conf
```bitbake
# We have a conf and classes directory, add to BBPATH
BBPATH .= ":${LAYERDIR}"

# We have recipes-* directories, add to BBFILES
BBFILES += "${LAYERDIR}/recipes-*/*/*.bb \
            ${LAYERDIR}/recipes-*/*/*.bbappend"

BBFILE_COLLECTIONS += "meta-alexi-distro"
BBFILE_PATTERN_meta-alexi-distro = "^${LAYERDIR}/"
BBFILE_PRIORITY_meta-alexi-distro = "6"

LAYERDEPENDS_meta-alexi-distro = "core"
LAYERSERIES_COMPAT_meta-alexi-distro = "gatesgarth hardknott"

LAYERDIR_ALEXI = "${LAYERDIR}"
```
